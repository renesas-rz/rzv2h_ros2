## meta-rz-features-ros/meta-rzv2-ros-humble/conf/layer.conf
```bitbake
# We have a conf and classes directory, add to BBPATH

BBPATH .= ":${LAYERDIR}"

LAYERSERIES_COMPAT_rzv2-ros-humble = "scarthgap"

BBFILE_COLLECTIONS += "rzv2-ros-humble"
BBFILE_PATTERN_rzv2-ros-humble = "^${LAYERDIR}/"
BBFILE_PRIORITY_rzv2-ros-humble = "99"

# We have recipes-* directories, add to BBFILES
BBFILES += "${LAYERDIR}/recipes-*/*/*.bb \
    ${LAYERDIR}/recipes-*/*.bb \
    ${LAYERDIR}/recipes-*/*.bbappend \
    ${LAYERDIR}/recipes-*/*/*.bbappend"
```
